#include <Adafruit_GFX.h>     // Include Adafruit Core graphics library
#include <Adafruit_ST7735.h>  // Include Adafruit Hardware-specific library for ST7735
#include <SPI.h>              // Include Arduino SPI library
#include <CuteBuzzerSounds.h>

#define TFT_RST 4
#define TFT_CS 6
#define TFT_DC 5

#define TFT_MOSI 10  // SDA pin on display (Data out)
#define TFT_SCLK 8   // SCL pin on display (Clock out)

#define BUZZER_PIN 7


Adafruit_ST7735 tft = Adafruit_ST7735(TFT_CS, TFT_DC, TFT_RST);

const int screenWidth = 160;  // Width of the display
const int screenHeight = 80;  // Height of the display

const int imageWidth = 30;   // Width of the image
const int imageHeight = 30;  // Height of the image

int xPosReel1, xPosReel2, xPosReel3, yPosReel1, yPosReel2, yPosReel3;

enum Symbols {
  CHERRY = 0,
  LEMON,
  ORANGE,
  PLUM,
  WATERMELON,
  BELL,
  DIAMOND,
  BAR,
  SEVEN
};

// Reel position index
int indexReel1, indexReel2, indexReel3;

bool bWin;
long delayCount;

const uint16_t sevenSymbol[imageWidth * imageHeight] PROGMEM = {

  0x001B, 0x001B, 0x001B, 0x001B, 0x001B, 0x001B, 0x081D, 0x001B, 0xFFFF, 0x001B, 0x001B, 0x001B, 0x001B, 0x001B, 0x001B, 0x001B, 0x001B, 0x001B, 0x001B, 0xFFFF, 0xFFFF, 0xFFFF, 0x001F, 0x001B, 0x081D, 0x001B, 0x001B, 0x0017, 0x0015, 0x0015,
  0x001B, 0x001B, 0x001B, 0x001B, 0x001B, 0x001B, 0x001C, 0x001B, 0x001B, 0x001C, 0x081C, 0x001B, 0x001B, 0x001B, 0x001B, 0x001C, 0x081C, 0x081C, 0x001B, 0x001B, 0x001C, 0x081B, 0xFFFF, 0x001B, 0x081D, 0x001B, 0x001A, 0x0015, 0x0016, 0x0015,
  0x001B, 0x001B, 0x001B, 0x001B, 0x001B, 0x001B, 0x001B, 0x001C, 0x081C, 0x001B, 0x001B, 0x001B, 0x001B, 0x001B, 0x001B, 0x001B, 0x001B, 0x001B, 0x001B, 0x081C, 0x081D, 0x001B, 0x001B, 0x001B, 0x001B, 0x001B, 0x0017, 0x0015, 0x0016, 0x0015,
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  0xFFFF, 0xFFFF, 0xFFFF, 0xFFFF, 0x0000, 0xFFFF, 0x0013, 0x0015, 0x0016, 0x0015, 0x0015, 0x0015, 0x0015, 0x0015, 0x0015, 0x0015, 0x0015, 0x0016, 0x0015, 0x0015, 0xFFFF, 0x000F, 0xFFFF, 0xFFFF, 0xFFFF, 0xFFFF, 0xFFFF, 0xFFFF, 0xFFFF, 0xFFFF
};

const uint16_t barSymbol[imageWidth * imageHeight] PROGMEM = {

  0xFFFF, 0xFFFF, 0xFFFF, 0xFFFF, 0xFFFF, 0xFFFF, 0xFFFF, 0xFFFF, 0xFFFF, 0xFFFF, 0xFFFF, 0xFFFF, 0xFFFF, 0xFFFF, 0xFFFF, 0xFFFF, 0xFFFF, 0xFFFF, 0xFFFF, 0xFFFF, 0xFFFF, 0xFFFF, 0xFFFF, 0xFFFF, 0xFFFF, 0xFFFF, 0xFFFF, 0xFFFF, 0xFFFF, 0xFFFF,
  0xFFFF, 0xFFFF, 0xFFFF, 0xFFFF, 0xFFFF, 0xFFFF, 0xFFFF, 0xFFFF, 0xFFFF, 0xFFFF, 0xFFFF, 0xFFFF, 0xFFFF, 0xFFFF, 0xFFFF, 0xFFFF, 0xFFFF, 0xFFFF, 0xFFFF, 0xFFFF, 0xFFFF, 0xFFFF, 0xFFFF, 0xFFFF, 0xFFFF, 0xFFFF, 0xFFFF, 0xFFFF, 0xFFFF, 0xFFFF,
  0xFFFF, 0xFFFF, 0xFFFF, 0xFFFF, 0xFFFF, 0xFFFF, 0xFFFF, 0xFFFF, 0xFFFF, 0xFFFF, 0xFFFF, 0xFFFF, 0xFFFF, 0xFFFF, 0xFFFF, 0xFFFF, 0xFFFF, 0xFFFF, 0xFFFF, 0xFFFF, 0xFFFF, 0xFFFF, 0xFFFF, 0xFFFF, 0xFFFF, 0xFFFF, 0xFFFF, 0xFFFF, 0xFFFF, 0xFFFF,
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  0xFFFF, 0xFFFF, 0xFFFF, 0xFFFF, 0xFFFF, 0xFFFF, 0xFFFF, 0xFFFF, 0xFFFF, 0xFFFF, 0xFFFF, 0xFFFF, 0xFFFF, 0xFFFF, 0xFFFF, 0xFFFF, 0xFFFF, 0xFFFF, 0xFFFF, 0xFFFF, 0xFFFF, 0xFFFF, 0xFFFF, 0xFFFF, 0xFFFF, 0xFFFF, 0xFFFF, 0xFFFF, 0xFFFF, 0xFFFF
};

const uint16_t diamondSymbol[imageWidth * imageHeight] PROGMEM = {

  0xFFFF, 0xFFFF, 0xFFFF, 0xFFFF, 0xFFFF, 0xFFFF, 0xFFFF, 0xFFFF, 0xFFFF, 0xFFFF, 0xFFFF, 0xFFFF, 0xFFFF, 0xFFFF, 0xFFFF, 0xFFFF, 0xFFFF, 0xFFFF, 0xFFFF, 0xFFFF, 0xFFFF, 0xFFFF, 0xFFFF, 0xFFFF, 0xFFFF, 0xFFFF, 0xFFFF, 0xFFFF, 0xFFFF, 0xFFFF,
  0xFFFF, 0xFFFF, 0xFFFF, 0xFFFF, 0xFFFF, 0xFFFF, 0xFFFF, 0xFFFF, 0xFFFF, 0xFFFF, 0xFFFF, 0xFFFF, 0xFFFF, 0xFFFF, 0xFFFF, 0xFFFF, 0xFFFF, 0xFFFF, 0xFFFF, 0xFFFF, 0xFFFF, 0xFFFF, 0xFFFF, 0xFFFF, 0xFFFF, 0xFFFF, 0xFFFF, 0xFFFF, 0xFFFF, 0xFFFF,
  0xFFFF, 0xFFFF, 0xFFFF, 0xFFFF, 0xC800, 0x49E0, 0x09E0, 0x09E0, 0x09E0, 0x09E0, 0x09E0, 0x09E0, 0x09E0, 0x09E0, 0x49E0, 0x8BE7, 0x8BE7, 0x8BE7, 0x8BE7, 0x8BE7, 0x8BE7, 0x8BE7, 0x8BE7, 0x8BE7, 0x8BE7, 0xCFFF, 0xFFFF, 0xFFFF, 0xFFFF, 0xFFFF,
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  0xFFFF, 0xFFFF, 0xFFFF, 0xFFFF, 0xFFFF, 0xFFFF, 0xFFFF, 0xFFFF, 0xFFFF, 0xFFFF, 0xFFFF, 0xFFFF, 0xFFFF, 0xFFFF, 0xFFFF, 0xFFFF, 0xFFFF, 0xFFFF, 0xFFFF, 0xFFFF, 0xFFFF, 0xFFFF, 0xFFFF, 0xFFFF, 0xFFFF, 0xFFFF, 0xFFFF, 0xFFFF, 0xFFFF, 0xFFFF
};


const uint16_t bellSymbol[imageWidth * imageHeight] PROGMEM = {

  0xFFFF, 0xFFFF, 0xFFFF, 0xFFFF, 0xFFFF, 0xFFFF, 0xFFFF, 0xFFFF, 0xFFFF, 0x07FF, 0x067F, 0x0DF7, 0x165D, 0x163D, 0x163D, 0x163D, 0x163D, 0x15BD, 0x0DF7, 0x067F, 0x07FF, 0xFFFF, 0xFFFF, 0xFFFF, 0xFFFF, 0xFFFF, 0xFFFF, 0xFFFF, 0xFFFF, 0xFFFF,
  0xFFFF, 0xFFFF, 0xFFFF, 0xFFFF, 0xFFFF, 0xFFFF, 0xFFFF, 0xFFFF, 0x255F, 0xFFFF, 0xFFFF, 0xFFFF, 0x161D, 0x16BF, 0x161D, 0x161D, 0x1EBF, 0x161D, 0xFFFF, 0xFFFF, 0xFFFF, 0x255F, 0xFFFF, 0xFFFF, 0xFFFF, 0xFFFF, 0xFFFF, 0xFFFF, 0xFFFF, 0xFFFF,
  0xFFFF, 0xFFFF, 0xFFFF, 0xFFFF, 0xFFFF, 0xFFFF, 0xFFFF, 0x255F, 0xFFFF, 0x063F, 0x16DF, 0x16DF, 0x169F, 0x167E, 0x161D, 0x161C, 0x161D, 0x163D, 0x163D, 0x163D, 0x055C, 0xFFFF, 0x255F, 0xFFFF, 0xFFFF, 0xFFFF, 0xFFFF, 0xFFFF, 0xFFFF, 0xFFFF,
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  0xFFFF, 0xFFFF, 0xFFFF, 0xFFFF, 0xFFFF, 0x07FF, 0x03FF, 0x2555, 0x0DF7, 0x0DFF, 0x055A, 0x0DFF, 0x0D7B, 0x163D, 0x163D, 0x163D, 0x163D, 0x0DFD, 0x0DF7, 0x055A, 0x0DF7, 0x0DF7, 0x2555, 0x03FF, 0x07FF, 0xFFFF, 0xFFFF, 0xFFFF, 0xFFFF, 0xFFFF
};

const uint16_t watermelonSymbol[imageWidth * imageHeight] PROGMEM = {

  0xFFFF, 0xFFFF, 0xFFFF, 0xFFFF, 0xFFFF, 0xFFFF, 0xFFFF, 0xFFFF, 0xFFFF, 0xFFFF, 0xFFFF, 0xFFFF, 0xFFFF, 0xFFFF, 0xFFFF, 0xFFFF, 0xFFFF, 0xFFFF, 0xFFFF, 0xFFFF, 0xFFFF, 0xFFFF, 0x018C, 0xFFFF, 0x0340, 0x0380, 0xFFFF, 0x22A0, 0x0000, 0xFFFF,
  0xFFFF, 0xFFFF, 0xFFFF, 0xFFFF, 0xFFFF, 0xFFFF, 0xFFFF, 0xFFFF, 0xFFFF, 0xFFFF, 0xFFFF, 0xFFFF, 0xFFFF, 0xFFFF, 0xFFFF, 0xFFFF, 0xFFFF, 0xFFFF, 0xFFFF, 0xFFFF, 0xFFFF, 0x0333, 0xFFFF, 0x0D04, 0x0443, 0x03C0, 0x0380, 0xFFFF, 0x22A0, 0xFFFF,
  0xFFFF, 0xFFFF, 0xFFFF, 0xFFFF, 0xFFFF, 0xFFFF, 0xFFFF, 0xFFFF, 0xFFFF, 0xFFFF, 0xFFFF, 0xFFFF, 0xFFFF, 0xFFFF, 0xFFFF, 0xFFFF, 0xFFFF, 0xFFFF, 0xFFFF, 0xFFFF, 0x0019, 0xFFFF, 0x0098, 0x0231, 0x0CC5, 0x0403, 0x0380, 0x0380, 0xFFFF, 0x22A0,
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  0xFFFF, 0xFFFF, 0x22A0, 0xFFFF, 0xFFFF, 0xFFFF, 0x0381, 0x0380, 0x0360, 0x0360, 0x0360, 0x0340, 0x0360, 0x0360, 0x0360, 0x0380, 0x0380, 0x03A1, 0xFFFF, 0xFFFF, 0x03E0, 0x03E0, 0xFFFF, 0xFFFF, 0xFFFF, 0xFFFF, 0xFFFF, 0xFFFF, 0xFFFF, 0xFFFF
};

const uint16_t plumSymbol[imageWidth * imageHeight] PROGMEM = {

  0xFFFF, 0xFFFF, 0xFFFF, 0xFFFF, 0xFFFF, 0x7AB5, 0xFFFF, 0xFFFF, 0x5250, 0x4A2F, 0x39EE, 0x31CD, 0x31CD, 0x39CD, 0x39CD, 0x39CD, 0x31CC, 0xFFFF, 0x4BEF, 0xFFFF, 0xFFFF, 0xFFFF, 0x0000, 0x09E7, 0x22AA, 0xFFFF, 0xFFFF, 0xFFFF, 0xFFFF, 0xFFFF,
  0xFFFF, 0xFFFF, 0xFFFF, 0xFFFF, 0x7AB5, 0xFFFF, 0x5250, 0x5251, 0x5251, 0x5A71, 0x5250, 0x4A2F, 0x39EE, 0x31CD, 0x39CD, 0x39EE, 0x39CD, 0x39CD, 0xFFFF, 0x22AA, 0x0000, 0x22AA, 0xFFFF, 0xFFFF, 0xFFFF, 0x22AA, 0x124A, 0x124B, 0x018C, 0xFFFF,
  0xFFFF, 0xFFFF, 0xFFFF, 0x49EF, 0xFFFF, 0x5250, 0x5251, 0x5A71, 0x5250, 0x5230, 0x5250, 0x5250, 0x5250, 0x420F, 0x31CD, 0x31CD, 0x39CD, 0x420E, 0x31CD, 0xFFFF, 0x22AA, 0xFFFF, 0x122A, 0x124A, 0x124A, 0x0A4A, 0x0A4A, 0x126B, 0x0A2A, 0xFFFF,
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  0xFFFF, 0xFFFF, 0xFFFF, 0xFFFF, 0xFFFF, 0x0000, 0x22AA, 0xFFFF, 0xFFFF, 0x31CD, 0x39CD, 0x31CD, 0x39CD, 0x31CD, 0x31CD, 0x31CD, 0x39CD, 0x39CD, 0x39ED, 0x39CD, 0xFFFF, 0xFFFF, 0xFFFF, 0x254A, 0xFFFF, 0xFFFF, 0xFFFF, 0xFFFF, 0xFFFF, 0xFFFF
};

const uint16_t orangeSymbol[imageWidth * imageHeight] PROGMEM = {

  0xFFFF, 0xFFFF, 0xFFFF, 0xFFFF, 0xFFFF, 0x0000, 0x055F, 0xFFFF, 0xFFFF, 0x0D3F, 0x2DBF, 0x3DDF, 0x45FF, 0x4E1F, 0x3DBE, 0x14DC, 0x03D9, 0x03D9, 0x041A, 0x043C, 0xFFFF, 0xFFFF, 0x09EF, 0x09E7, 0x4BEF, 0xFFFF, 0xFFFF, 0xFFFF, 0xFFFF, 0xFFFF,
  0xFFFF, 0xFFFF, 0xFFFF, 0xFFFF, 0x07FF, 0x001F, 0xFFFF, 0x04BF, 0x04BF, 0x04BF, 0x04FF, 0x04FF, 0x04FF, 0x04FF, 0x259F, 0x4E3F, 0x359E, 0x041A, 0x03D9, 0x03D9, 0x03FA, 0x03B7, 0xFFFF, 0xFFFF, 0xFFFF, 0x1249, 0x122A, 0x122A, 0x09E7, 0xFFFF,
  0xFFFF, 0xFFFF, 0xFFFF, 0x03FF, 0xFFFF, 0x02B5, 0x04BF, 0x04BF, 0x04FF, 0x04BF, 0x049E, 0x047E, 0x047E, 0x049E, 0x047E, 0x153E, 0x563F, 0x1CFC, 0x0398, 0x03D9, 0x041B, 0x03FA, 0x0333, 0x0A29, 0x0A4B, 0x0A4A, 0x0A2A, 0x124B, 0x0A2A, 0xFFFF,
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  0xFFFF, 0xFFFF, 0xFFFF, 0xFFFF, 0xFFFF, 0x001F, 0x055F, 0xFFFF, 0xFFFF, 0x03D9, 0x03D9, 0x03B8, 0x03B8, 0x03B8, 0x03B8, 0x03B8, 0x03D9, 0x03D9, 0x03D9, 0x03DA, 0xFFFF, 0xFFFF, 0xFFFF, 0x254A, 0xFFFF, 0xFFFF, 0xFFFF, 0xFFFF, 0xFFFF, 0xFFFF
};

const uint16_t lemonSymbol[imageWidth * imageHeight] PROGMEM = {

  0xFFFF, 0xFFFF, 0xFFFF, 0xFFFF, 0xFFFF, 0xFFFF, 0xFFFF, 0xFFFF, 0xFFFF, 0xFFFF, 0x4BE0, 0xFFFF, 0xFFFF, 0x1506, 0x14E6, 0x14E6, 0x14C6, 0x14C6, 0x14E6, 0x14E6, 0x14E6, 0xFFFF, 0xFFFF, 0x4BE0, 0xFFFF, 0xFFFF, 0xFFFF, 0xFFFF, 0xFFFF, 0xFFFF,
  0xFFFF, 0xFFFF, 0xFFFF, 0xFFFF, 0xFFFF, 0xFFFF, 0xFFFF, 0xFFFF, 0xFFFF, 0x07E0, 0xFFFF, 0x14A6, 0x14E6, 0x14E6, 0x1D06, 0x14E6, 0x14E6, 0x14C6, 0x14C6, 0x1506, 0x1506, 0x14E6, 0x14A5, 0xFFFF, 0x254A, 0xFFFF, 0xFFFF, 0xFFFF, 0xFFFF, 0xFFFF,
  0xFFFF, 0xFFFF, 0xFFFF, 0xFFFF, 0xFFFF, 0xFFFF, 0xFFFF, 0xFFFF, 0x254A, 0x0000, 0x14C6, 0x1506, 0x1D27, 0x14E7, 0x14C6, 0x14C6, 0x14C6, 0x14C6, 0x14C6, 0x14C6, 0x14C6, 0x1D27, 0x14E6, 0x0CC9, 0xFFFF, 0x0BE7, 0x07E0, 0xFFFF, 0xFFFF, 0xFFFF,
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  0x05FD, 0x053A, 0x053A, 0x053A, 0x05BC, 0x053A, 0x055A, 0x053A, 0x0539, 0x0539, 0x0539, 0x053A, 0x055A, 0x055A, 0x0559, 0xFFFF, 0xFFFF, 0x03F7, 0xFFFF, 0xFFFF, 0xFFFF, 0xFFFF, 0xFFFF, 0xFFFF, 0xFFFF, 0xFFFF, 0xFFFF, 0xFFFF, 0xFFFF, 0xFFFF
};

const uint16_t cherriesSymbol[imageWidth * imageHeight] PROGMEM = {

  0xFFFF, 0xFFFF, 0xFFFF, 0xFFFF, 0xFFFF, 0xFFFF, 0xFFFF, 0xFFFF, 0x0DE7, 0xFFFF, 0x0CA5, 0x1DC7, 0x1DC7, 0x1DA7, 0x1DA7, 0x1DC7, 0x1DC7, 0x1D67, 0xFFFF, 0xFFFF, 0x4BE0, 0x0BE0, 0x0BE0, 0x22AA, 0xFFFF, 0xFFFF, 0xFFFF, 0xFFFF, 0xFFFF, 0xFFFF,
  0xFFFF, 0xFFFF, 0xFFFF, 0xFFFF, 0xFFFF, 0xFFFF, 0xFFFF, 0x0DE7, 0xFFFF, 0x1566, 0x1DC7, 0x1E07, 0x1DC7, 0x1DC7, 0x1DC7, 0x1DE7, 0x1DE7, 0x1DC7, 0x1DC7, 0x26A7, 0xFFFF, 0xFFFF, 0xFFFF, 0xFFFF, 0x0A4A, 0x124A, 0x0A4A, 0xFFFF, 0x4BEF, 0xFFFF,
  0xFFFF, 0xFFFF, 0xFFFF, 0xFFFF, 0xFFFF, 0xFFFF, 0x0DE7, 0xFFFF, 0x1566, 0x1DC7, 0x1E07, 0x15A6, 0x1566, 0x1545, 0x1505, 0x14E4, 0x0CE4, 0x14E4, 0x1564, 0x0CA2, 0x0460, 0x0480, 0x0BA4, 0x0A2A, 0x124A, 0x124A, 0x0A4A, 0x0000, 0x000F, 0xFFFF,
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  0xFFFF, 0xFFFF, 0xFFFF, 0x2015, 0xFFFF, 0xFFFF, 0xFFFF, 0x0015, 0x0014, 0x0014, 0x0015, 0xFFFF, 0xFFFF, 0xFFFF, 0x0817, 0xFFFF, 0x080F, 0x0014, 0x0034, 0x0034, 0x0033, 0x0033, 0x0034, 0x0034, 0x0034, 0x0012, 0xFFFF, 0x2015, 0xFFFF, 0xFFFF
};

// Define the reel arrays based on winning probabilities
const int reel1[] = {CHERRY, LEMON, ORANGE, PLUM, WATERMELON, BELL, DIAMOND, BAR, SEVEN, CHERRY, ORANGE, PLUM, WATERMELON, BELL, DIAMOND, BAR, SEVEN, CHERRY, PLUM, DIAMOND, WATERMELON, BELL, ORANGE, SEVEN, LEMON, BAR, CHERRY, SEVEN, WATERMELON, BELL};
const int reel2[] = {ORANGE, LEMON, PLUM, CHERRY, WATERMELON, DIAMOND, BAR, BELL, SEVEN, LEMON, CHERRY, ORANGE, WATERMELON, PLUM, SEVEN, BAR, DIAMOND, BELL, SEVEN, ORANGE, WATERMELON, LEMON, BELL, CHERRY, PLUM, DIAMOND, BAR, ORANGE, SEVEN, LEMON};
const int reel3[] = {PLUM, ORANGE, CHERRY, LEMON, WATERMELON, BELL, BAR, DIAMOND, SEVEN, SEVEN, ORANGE, PLUM, WATERMELON, LEMON, SEVEN, CHERRY, DIAMOND, BAR, SEVEN, BELL, WATERMELON, CHERRY, LEMON, ORANGE, PLUM, BELL, DIAMOND, SEVEN, ORANGE, BAR};

int lengthReel1, lengthReel2, lengthReel3;

// Function to draw a symbol based on its identifier
void drawSymbol(int symbol, int x, int y) {
  const uint16_t* bitmap;
  switch (symbol) {
    case SEVEN:
      bitmap = sevenSymbol;
      break;
    case BAR:
      bitmap = barSymbol;
      break;
    case DIAMOND:
      bitmap = diamondSymbol;
      break;
    case BELL:
      bitmap = bellSymbol;
      break;
    case WATERMELON:
      bitmap = watermelonSymbol;
      break;
    case PLUM:
      bitmap = plumSymbol;
      break;
    case ORANGE:
      bitmap = orangeSymbol;
      break;
    case LEMON:
      bitmap = lemonSymbol;
      break;
    case CHERRY:
      bitmap = cherriesSymbol;
      break;

      // ... Add cases for other symbols
  }
  tft.drawRGBBitmap(x, y, bitmap, imageWidth, imageHeight);
}

void drawAllSymbols(int offset1 = 0, int offset2 = 0, int offset3 = 0) {
  // Calculate offset of reels on top row
  int indexReel1Top = (indexReel1 - 1 < 0 ? (lengthReel1 - 1) : indexReel1 - 1);
  int indexReel2Top = (indexReel2 - 1 < 0 ? (lengthReel2 - 1) : indexReel2 - 1);
  int indexReel3Top = (indexReel3 - 1 < 0 ? (lengthReel3 - 1) : indexReel3 - 1);

  // Calculate offset of reels on bottom row
  int indexReel1Bottom = (indexReel1 + 1 > (lengthReel1 - 1) ? 0 : indexReel1 + 1);
  int indexReel2Bottom = (indexReel2 + 1 > (lengthReel2 - 1) ? 0 : indexReel2 + 1);
  int indexReel3Bottom = (indexReel3 + 1 > (lengthReel3 - 1) ? 0 : indexReel3 + 1);

  // Center
  drawSymbol(reel1[indexReel1], xPosReel1, yPosReel1);
  drawSymbol(reel2[indexReel2], xPosReel2, yPosReel2);
  drawSymbol(reel3[indexReel3], xPosReel3, yPosReel3);

  // Top
  drawSymbol(reel1[indexReel1Top], xPosReel1, yPosReel1 - 40 + offset1);
  drawSymbol(reel2[indexReel2Top], xPosReel2, yPosReel2 - 40 + offset2);
  drawSymbol(reel3[indexReel3Top], xPosReel3, yPosReel3 - 40 + offset3);

  // Draw a white square under the symbols to prevent dragging
  if (!offset1) tft.fillRect(xPosReel1, yPosReel1 - 40 + offset1 + 30, imageWidth, 10, ST77XX_WHITE);
  if (!offset2) tft.fillRect(xPosReel2, yPosReel2 - 40 + offset2 + 30, imageWidth, 10, ST77XX_WHITE);
  if (!offset3) tft.fillRect(xPosReel3, yPosReel3 - 40 + offset3 + 30, imageWidth, 10, ST77XX_WHITE);

  // Bottom
  drawSymbol(reel1[indexReel1Bottom], xPosReel1, yPosReel1 + 40 + offset1);
  drawSymbol(reel2[indexReel2Bottom], xPosReel2, yPosReel2 + 40 + offset2);
  drawSymbol(reel3[indexReel3Bottom], xPosReel3, yPosReel3 + 40 + offset3);
}

int spinReels() {

  for (int i = 0; i < random(10)+3; i++) {
    drawAllSymbols(20, 20, 20);
    indexReel1++;
    indexReel2++;
    indexReel3++;
    if (indexReel1 >= lengthReel1) indexReel1 = 0;
    if (indexReel2 >= lengthReel2) indexReel2 = 0;
    if (indexReel3 >= lengthReel3) indexReel3 = 0;
    drawAllSymbols(0, 0, 0);
  }
  cute._tone(NOTE_G5, 50, 0);

  for (int i = 0; i < random(10)+3; i++) {
    drawAllSymbols(0, 20, 20);
    indexReel2++;
    indexReel3++;
    if (indexReel2 >= lengthReel2) indexReel2 = 0;
    if (indexReel3 >= lengthReel3) indexReel3 = 0;
    drawAllSymbols(0, 0, 0);
  }
  cute._tone(NOTE_G5, 50, 0);

  for (int i = 0; i < random(10)+3; i++) {
    drawAllSymbols(0, 0, 20);
    indexReel3++;
    if (indexReel3 >= lengthReel3) indexReel3 = 0;
    drawAllSymbols(0, 0, 0);
  }
  cute._tone(NOTE_E5, 50, 0);

  return 0;
}

void setup() {

  Serial.begin(115200);
  // while (!Serial);

  // put your setup code here, to run once:
  pinMode(D0, OUTPUT);
  pinMode(D1, INPUT);

  cute.init(BUZZER_PIN);

  // Initialize the ST7735 TFT display
  tft.initR(INITR_MINI160x80);

  // Rotate screen to horizontal position
  tft.setRotation(3);

  tft.fillScreen(ST77XX_WHITE);

  // Spacing Reels on X axis: 10 [30] 25 [30] 25 [30] 10
  xPosReel1 = 5;
  xPosReel2 = 60;
  xPosReel3 = 115;

  yPosReel1 = 25;
  yPosReel2 = 25;
  yPosReel3 = 25;

  randomSeed(micros() + analogRead(A2));
  Serial.println(micros() + analogRead(A2));

  lengthReel1 = sizeof(reel1)/sizeof(int);
  lengthReel2 = sizeof(reel2)/sizeof(int);
  lengthReel3 = sizeof(reel3)/sizeof(int);

  indexReel1 = random(lengthReel1 - 1);
  indexReel2 = random(lengthReel2 - 1);
  indexReel3 = random(lengthReel3 - 1);

  Serial.print("reel 1 index: ");
  Serial.println(indexReel1);

  Serial.print("reel 2 index: ");
  Serial.println(indexReel2);

  Serial.print("reel 3 index: ");
  Serial.println(indexReel3);

  drawAllSymbols();
}

//CHERRY, LEMON, ORANGE, PLUM, WATERMELON, BELL, DIAMOND, BAR, SEVEN, CHERRY, ORANGE, PLUM, WATERMELON, BELL, DIAMOND, BAR, SEVEN, CHERRY, PLUM, DIAMOND, WATERMELON, BELL, ORANGE, SEVEN, LEMON, BAR, CHERRY, SEVEN, WATERMELON, BELL};
int checkWin() {
  if (
    (reel1[indexReel1] == CHERRY)
      || (reel1[indexReel1] == reel2[indexReel2]) 
      || (reel1[indexReel1] == reel2[indexReel2] && reel2[indexReel2] == reel3[indexReel3])
    ) {
    Serial.print("reel1 index:");
    Serial.println(reel1[indexReel1]);
    Serial.print("reel2 index:");
    Serial.println(reel2[indexReel2]);
    Serial.print("reel3 index:");
    Serial.println(reel3[indexReel3]);


    delayCount = 0;
    digitalWrite(D0, HIGH);
    cute.play(S_HAPPY_SHORT);
    return 1;
  } else {
    return 0;
  }
}

void blinkLed() {
  if (delayCount < 100000) {
    digitalWrite(D0, HIGH);
  } else if (delayCount > 100000) {
    digitalWrite(D0, LOW);
  }

  if (delayCount > 200000) {
    delayCount = 0;
  }
  delayCount++;
}


void loop() {

  if (digitalRead(D1) == LOW) {
    digitalWrite(D0, LOW);
    cute.play(S_CONNECTION);
    spinReels();
    bWin = checkWin();
  }
  if (bWin) {
    blinkLed();
  }
}
